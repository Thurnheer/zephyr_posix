## CMakeLists.txt
```
cmake_minimum_required(VERSION 3.14)
find_package(Zephyr HINTS $ENV{ZEPHYR_BASE})

project(copOnZephyr)

target_link_libraries(app
    PRIVATE
        cop::cop
)

target_sources(app
    PRIVATE
        src/main.cpp
        src/uart.cpp
)
```

## prj.conf
```kconfig
CONFIG_CPLUSPLUS=y
CONFIG_STD_CPP2A=y
```

## src/main.cpp
```c
#include <zephyr.h>
#include <sys/printk.h>
#include <drivers/uart.h>
#include <cop/TransportLinkLayer.hpp>
#include <cop/DataLinkLayer.hpp>
#include <array>
#include "uart.hpp"

enum Events {
    eHelloWorld
};

struct HelloWorld : cop::Event<eHelloWorld> {
    char H = 'H';
    char e = 'e';
    char l = 'l';
    char ll = 'l';
    char o = 'o';
    char s = ' ';
    char W = 'W';
    char oo = 'o';
    char r = 'r';
    char lll = 'l';
    char d = 'd';
    char n = '\n';

    template<class Coder>
    auto parse(Coder coder) {
        return coder | H | e | l | ll | o | s | W | o | r | lll | d | n;
    }
};

class Handler {
public:
    void handle(HelloWorld& hw) {
        printk("hw reseived\n");
    }
};

const static size_t BUF_SIZE = 12;
const std::array<std::byte, BUF_SIZE> buf = {
    std::byte('H'), std::byte('e'), std::byte('l'), std::byte('l'),
    std::byte('o'), std::byte(' '), std::byte('W'), std::byte('o'),
    std::byte('r'), std::byte('l'), std::byte('d'), std::byte('\n')
};

class Channel {
public:
    Channel(Handler& handler) : buffer_(), uart_(), tll_(handler) {}

    void sendEvent(HelloWorld& hw) {
        auto it = buffer_.begin(); auto end = buffer_.end();
        tll_.sendEvent(hw, it, end);
        cop::DataLinkLayer<ReadIt> dll_(it, end);
        dll_.send(uart_);
    }
        
private:
    static constexpr size_t size_ = 128;
    std::array<std::byte, size_> buffer_;
    using ReadIt = std::array<std::byte, size_>::iterator;
    using Itr = std::array<std::byte, size_>::const_iterator;
    Uart<ReadIt> uart_;
    cop::TransportLinkLayer<Handler, ReadIt, std::tuple<HelloWorld> >tll_;

};

int main() {
    k_sleep(K_MSEC(500));
    Handler h;
    Channel c(h);
    HelloWorld hw;
    hw.r = 'R';
    c.sendEvent(hw);
    
    while(1){
        k_sleep(K_MSEC(100));
    }

    return 0;
}
```

## src/uart.hpp
```c
#ifndef COP_ON_ZEPHYR_UART_HPP
#define COP_ON_ZEPHYR_UART_HPP

#include <zephyr.h>
#include <cstddef>
#include <drivers/uart.h>

template<class Iterator>
class Uart {
public:
    Uart()
    : uart_(device_get_binding(CONFIG_UART_CONSOLE_ON_DEV_NAME))
    , begin_()
    , end_()
    {
        uart_irq_callback_user_data_set(uart_, tx_callback, this);
        tx_callback(uart_, this);
    }

    ~Uart(){
        uart_irq_tx_disable(uart_);
        uart_irq_rx_disable(uart_);
    }

    void send(Iterator begin, Iterator end)
    {
        begin_ = begin;
        end_ = end;
        uart_irq_tx_enable(uart_);
    }

private:
    static void tx_callback(const struct device* dev, void* uart)
    {
        Uart* this_ = reinterpret_cast<Uart*>(uart);
        if(!uart_irq_update(dev)) {
            return;
        }
        if(uart_irq_tx_ready(dev) && this_->begin_ != this_->end_) {
            uart_fifo_fill(dev, (uint8_t*)&(*this_->begin_), 1);
            this_->begin_++;
            if(this_->begin_ == this_->end_) {
                uart_irq_tx_disable(dev);
            }
        }
        if(uart_irq_rx_ready(dev)) {
            uint8_t recData;
            uart_fifo_read(dev, &recData, 1);
            this_->receive(std::byte(recData));
        }
    }

    void receive(std::byte data){
    }
    const struct device* uart_;
    Iterator begin_;
    Iterator end_;

};

#endif // COP_ON_ZEPHYR_UART_HPP
```
