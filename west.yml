## west.yml
```yaml
manifest:
    remotes:
        - name: christoph
          url-base: git@github.com:thurnheer
        - name: zephyr
          url-base: https://github.com/hexagon-geo-surv/
        - name: zephyrproject-rtos
          url-base: https://github.com/zephyrproject-rtos
    projects:
        - name: zephyr
          remote: zephyr
          revision: static_local_initialisation
          west-commands: scripts/west-commands.yml
        - name: cmsis
          path: modules/hal/cmsis
          remote: zephyrproject-rtos
        - name: hal_stm32
          path: modules/hal/stm32
          remote: zephyrproject-rtos
    self:
        path: cpoOnZephyr
```
